## package/boot/uboot-sunxi/src/configs/DolphinPi_defconfig
```kconfig
# ARCH
CONFIG_ARM=y
CONFIG_ARCH_SUNXI=y
CONFIG_MACH_SUN8I_V3S=y
CONFIG_DRAM_CLK=360
CONFIG_DRAM_ZQ=14779

# DTS
CONFIG_DEFAULT_DEVICE_TREE="sun8i-v3s-dolphinpi"
CONFIG_OF_LIBFDT_OVERLAY=y

# COMMON
CONFIG_SPL=y

# DEBUG
CONFIG_LOGLEVEL=7
CONFIG_CONS_INDEX=3

### ENV
CONFIG_ENV_IS_NOWHERE=y
# CONFIG_ENV_IS_IN_FLASH=y
# CONFIG_ENV_OFFSET=0x80000
# CONFIG_ENV_SIZE=0x02000

### NOR
## SPI
# CONFIG_SPI=y
# CONFIG_SPI_BOOT=y
# CONFIG_SUNXI_SPI=y
# CONFIG_SPL_SPI_SUPPORT=y
# CONFIG_SPL_SPI_SUNXI=y

### NAND
CONFIG_CLK=y
CONFIG_CLK_SUNXI=y
CONFIG_CLK_SUN8I_V3S=y
CONFIG_SUNXI_SPI=y
CONFIG_SPI_SUNXI=y
CONFIG_CMD_MTD=y
CONFIG_MTD=y
CONFIG_MTD_SPI_NAND=y
CONFIG_SPI=y
CONFIG_SPI_MEM=y
CONFIG_SPI_SUNXI=y
CONFIG_SPL_SPINAND_SUNXI=y
CONFIG_DM=y
CONFIG_DM_SPI=y
CONFIG_CMD_DM=y
CONFIG_CMD_SPI=y

CONFIG_BOOTCOMMAND="mtd read spi-nand0 $kernel_addr_r 0x0110000 0x400000; mtd read spi-nand0 $fdt_addr_r 0x0100000 0x10000; bootm 0x41000000 - 0x41800000"
CONFIG_BOOTARGS="console=ttyS0,115200 earlyprintk panic=5 rootwait mtdparts=spi0.0:1M(uboot)ro,64k(dtb)ro,4M(kernel)ro,-(rootfs) root=mtdblock3 rw rootfstype=jffs2"
```

## target/linux/sunxi/image/Config.in
```kconfig
config SUNXI_SD_BOOT_PARTSIZE
	int "Boot (SD Card) filesystem partition size (in MB)"
	depends on TARGET_sunxi
	default 20

if TARGET_sunxi_cortexa7v3sspinand

menuconfig SUN8I_V3S_SPINAND_OPTIONS
	bool "SPI-NAND options"
	default y if TARGET_sunxi_cortexa7v3sspinand

config SUNXI_SPINAND_PAGESIZE
	int "SPI-NAND pagesize size"
	depends on TARGET_sunxi_cortexa7v3sspinand
	depends on SUN8I_V3S_SPINAND_OPTIONS
	default 2048
	range 1024 8192

config SUNXI_SPINAND_BLOCKSIZE
	int "SPI-NAND block-size (in KiB)"
	depends on TARGET_sunxi_cortexa7v3sspinand
	depends on SUN8I_V3S_SPINAND_OPTIONS
	default 128

config SUN8I_V3S_OFFSET_UBI
	int "Offset of ubi in the spi-nand"
	depends on TARGET_sunxi_cortexa7v3sspinand
	depends on SUN8I_V3S_SPINAND_OPTIONS
	default 1048576 if SUNXI_SPINAND_PAGESIZE = 2048

menuconfig SUN8I_V3S_SPINAND_DUPLICATE_BOOT
	bool "Duplicate SPL and u-boot for better fail-safty"
	depends on TARGET_sunxi_cortexa7v3sspinand
	default n
	help
	  Copies the SPL multiple times to the different EGON-entrypoints and PEBs.
	  Also copies u-boot multiple times in case one gets corrputed

if SUN8I_V3S_SPINAND_DUPLICATE_BOOT

config SUN8I_V3S_SPINAND_DUPLICATE_BOOT_SPL
	int "Amount of SPLs stored"
	depends on SUN8I_V3S_SPINAND_DUPLICATE_BOOT
	range 1 8
	default 4
	help 
	  eGON.BROM searches for an valid SPL at pages 0, 32, 64, 96, 128, 160, 192 and 224.
	  We can put the SPL multiple times to each of the entry-points and eGON.BROM would load the SPL
	  from page 32 if the SPL on page 0 is corrupted. When changing the default value, don't forget to 
	  change CONFIG_SUN8I_V3S_OFFSET_UBI!

config SUN8I_V3S_SPINAND_DUPLICATE_BOOT_UBOOT
	int "Amount of u-boots stored"
	depends on SUN8I_V3S_SPINAND_DUPLICATE_BOOT
	range 1 8
	default 2
	help
	  The spi-nand spl is able to load another u-boot if it finds that the first u-boot is corrupted.
	  Enter the amount of u-boots you want to have on your spi-nand.
	  When changing the default value, don't forget to change CONFIG_SUN8I_V3S_OFFSET_UBI!

endif # SUN8I_V3S_SPINAND_DUPLICATE_BOOT

endif # TARGET_sunxi_cortexa7v3sspinand
```
